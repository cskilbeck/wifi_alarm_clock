## alarm_clock_firmware/main/Kconfig.projbuild
```kconfig
menu "BLE Provisioning"

    config BT_BLE_BLUFI_ENABLE
        bool "BLUFI enabled"
        default y

    config BTDM_CTRL_MODE_BLE_ONLY
        bool "BLE/BTDM Control mode - BLE only?"
        default y

    config BTDM_CTRL_MODE_BR_EDR_ONLY
        bool "BTDM_CTRL_MODE_BR_EDR_ONLY"
        default n

    config BTDM_CTRL_MODE_BTDM
        bool "BTDM_CTRL_MODE_BTDM"
        default n

endmenu
```

## alarm_clock_firmware/sdkconfig.defaults
```kconfig
#
# Bootloader config
#
CONFIG_BOOTLOADER_OFFSET_IN_FLASH=0x1000
CONFIG_BOOTLOADER_COMPILER_OPTIMIZATION_SIZE=y

CONFIG_FREERTOS_ENABLE_BACKWARD_COMPATIBILITY=y

#
# Serial flasher config
#
CONFIG_ESPTOOLPY_FLASHSIZE_DETECT=y
CONFIG_ESPTOOLPY_BEFORE_RESET=y
# end of Serial flasher config

#
# Partition Table
#
CONFIG_PARTITION_TABLE_SINGLE_APP=y
CONFIG_PARTITION_TABLE_OFFSET=0x8000
CONFIG_PARTITION_TABLE_MD5=y
# end of Partition Table

# Override some defaults so BT stack is enabled and
CONFIG_BT_ENABLED=y
CONFIG_BTDM_CTRL_MODE_BLE_ONLY=y
CONFIG_BTDM_CTRL_MODE_BR_EDR_ONLY=n
CONFIG_BTDM_CTRL_MODE_BTDM=n
CONFIG_BT_NIMBLE_ENABLED=y

## For Bluedroid as binary is larger than default size
CONFIG_PARTITION_TABLE_CUSTOM=y
CONFIG_PARTITION_TABLE_CUSTOM_FILENAME="partitions.csv"
CONFIG_PARTITION_TABLE_FILENAME="partitions.csv"
```
